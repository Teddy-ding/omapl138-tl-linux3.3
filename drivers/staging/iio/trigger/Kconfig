## drivers/staging/iio/trigger/Kconfig
```kconfig
#
# Industrial I/O standalone triggers
#
comment "Triggers - standalone"

if IIO_TRIGGER

config IIO_PERIODIC_RTC_TRIGGER
	tristate "Periodic RTC triggers"
	depends on RTC_CLASS
	help
	  Provides support for using periodic capable real time
	  clocks as IIO triggers.

config IIO_GPIO_TRIGGER
	tristate "GPIO trigger"
	depends on GENERIC_GPIO
	help
	  Provides support for using GPIO pins as IIO triggers.

config IIO_SYSFS_TRIGGER
	tristate "SYSFS trigger"
	depends on SYSFS
	help
	  Provides support for using SYSFS entry as IIO triggers.
	  If unsure, say N (but it's safe to say "Y").

	  To compile this driver as a module, choose M here: the
	  module will be called iio-trig-sysfs.

config IIO_BFIN_TMR_TRIGGER
	tristate "Blackfin TIMER trigger"
	depends on BLACKFIN
	select BFIN_GPTIMERS
	help
	  Provides support for using a Blackfin timer as IIO triggers.
	  If unsure, say N (but it's safe to say "Y").

	  To compile this driver as a module, choose M here: the
	  module will be called iio-trig-bfin-timer.

config IIO_DAVINCI_TMR_TRIGGER
	tristate "Davinci TIMER trigger"
	select ARCH_DAVINCI_DA8XX
	help
	  Provides support for using a Davinci timer as IIO triggers.
	  If unsure, say N (but it's safe to say "Y").

	  To compile this driver as a module, choose M here: the
	  module will be called iio-trig-davinci-timer.

endif # IIO_TRIGGER
```
